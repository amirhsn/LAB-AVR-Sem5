.include"m8535def.inc"
.org 0

RJMP MAIN
MAIN: 
	LDI R16,LOW(RAMEND)
	OUT SPL,R16
	LDI R16,HIGH(RAMEND)
	OUT SPH,R16
	LDI R20,8
	
	LDI R31,$FF
	OUT DDRA,R31
	OUT DDRB,R31
	
	RJMP SEC1

SEC4:
	ADD R11,R20
SEC1:

	LDI R16,60
	LDI R30,LOW(2*DAT1)
	LDI R31,HIGH(2*DAT1)
	ADD R30,R11
	ADC R31,R0
	LDI R17,$FF
TAMPIL:

	LSR R1
	ROR R17
	ADC R1,R0

	;BLINKING
	CPI R30,LOW(2*DAT1)+8
	BREQ NOB
	BRCS NOB
	CPI R30,LOW(2*DAT1)+16
	BREQ NOB
	BRCC NOB
	CPI R16,30
	BRCS NOB
	OUT PORTA,R15
	LDI R19,0
	OUT PORTB,R19
	ADIW R31:R30,1
	RCALL DELAY
	RJMP BLINKED
NOB:

	OUT PORTA,R17
	LPM R18,Z+
	OUT PORTB,R18	;R18=DATA DISPLAYED
	RCALL DELAY
BLINKED:
	INC R21
	CPI R21,8
	BRNE TAMPIL
	LDI R17,$FF
	CLR R1
	CLR R21
	SUB R30,R20
	SBC R31,R0
	DEC R16
	BRNE TAMPIL
	INC R22
	CPI R22,4
	BRNE SEC1
	CLR R22
	CPI R30,LOW(2*DAT1)+16
	BRCS SEC4
	CLR R11
	RJMP SEC1


END: RJMP END
DELAY:
;CLOCK FOR DELAY
;8.000.000 / (60*8) = 16.666
;
	PUSH R16
	PUSH R17
	PUSH R18
    LDI R16,1
D0: LDI R17,10
D1: LDI R18,207
D2: NOP
    NOP
	NOP
	NOP
	NOP


    DEC R18
    BRNE D2
    DEC R17
    BRNE D1
    DEC R16
    BRNE D0
    NOP
	POP R18
	POP R17
	POP R16
    RET


.org $60
	DAT1:
	;--RA 	:	JIN-
	.DB $40,$40,$31,$77
	.DB $0E,$06,$54,$40
	;DAT2:
	;-JUJ 	:	UR--
	.DB $40,$0E,$3E,$0E
	.DB $3E,$31,$40,$40
	;DAT3:
	;--TU 	:	LUS-
	.DB $40,$40,$78,$3E
	.DB $38,$3E,$6D,$40
