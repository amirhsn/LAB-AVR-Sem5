.INCLUDE "M8535DEF.INC"
.ORG 0
//AMIR HUSEIN (181344003)
RJMP MAIN
MAIN:
LDI R16, LOW(RAMEND)
OUT SPL, R16
LDI R16, HIGH(RAMEND)
OUT SPH, R16

//POINTER INITIALIZATION
LDI R18, 1
//PROCESS DAT1 FIRST
LDI ZL, LOW(2*DAT1)
LDI ZH, HIGH(2*DAT1)

LPM R20, Z+
RCALL JUMLAH

//THEN PROCESS DAT2
LDI R18, 0 
LDI ZL, LOW(2*DAT2)
LDI ZH, HIGH(2*DAT2)
RCALL JUMLAH

//STORE RESULT TO DATA AREA
LDI ZL, LOW(HASIL)
LDI ZH, HIGH(HASIL)
ST Z+, R20
ST Z+, R21

AKHIR: RJMP AKHIR

JUMLAH:
LPM R19, Z+
ADD R20, R19
ADC R21, R17
INC R18
CPI R18, $4
BRLO JUMLAH
RET

.ORG $90
DAT1: .DB $1E, $32, $7A, $77

.ORG $96
DAT2: .DB $54, $68, $69, $40 

.ORG $60
HASIL: .DB 0
