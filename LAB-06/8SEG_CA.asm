.INCLUDE "M8535DEF.INC"
.ORG 0

RJMP MAIN
MAIN:
LDI R16, LOW(RAMEND)
OUT SPL, R16
LDI R16, HIGH(RAMEND)
OUT SPH, R16

//PORT A DAN B SEBAGAI OUTPUT
LDI R20, 0XFF
OUT DDRA, R20 
OUT DDRB, R20 
LDI R16, 240 //60FRAMEX4

ULANG:
LDI ZL, LOW(2*DAT)
LDI ZH, HIGH(2*DAT)
LDI R23, 0X8 //1 FRAME 8 KAR

TAMPIL:
LPM R21,Z+
OUT PORTA, R21
LPM R22,Z+
OUT PORTB, R22
RCALL DELAY
DEC R23 //COUNTER
BRNE TAMPIL
DEC R16
BRNE ULANG
//MATIKAN
LDI R17, 0XFF
OUT PORTB, R17

AKHIR: RJMP AKHIR

DELAY: //SEKITAR 2MS
LDI R25, 4
LUP1:
LDI R24, 0XAA
LUP:
DEC R24
BRNE LUP
DEC R25
BRNE LUP1
RET

.ORG 80
DAT:
//POSISI DIGIT DAN POLA KARAKTER SELANG SELING
.DB $80,$C0,$40,$F9,$20,$A4,$10,$B0,$08,$99,$04,$92,$02,$82,$01,$F8
