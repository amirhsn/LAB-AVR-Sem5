.INCLUDE "M8535DEF.INC"
.ORG 0

RJMP MAIN
MAIN:
LDI R16, LOW(RAMEND)
OUT SPL, R16
LDI R16, HIGH(RAMEND)
OUT SPH, R16

//PORT A DAN C SEBAGAI OUTPUT
LDI R20, $FF
OUT DDRA, R20 //PERDELAPANAN
OUT DDRC, R20 //SATUAN

AWALBGT:
LDI R16,1 //COUNTER PERDELAPANAN

AWAL:
LDI R17,0 //COUNTER SATUAN

//INISIALIASI POINTER X, Y & Z
LDI XL, 0X15
LDI XH, 0
LDI YL, 0X16
LDI YH, 0
LDI ZL, LOW(2*DAT)
LDI ZH, HIGH(2*DAT)

LPM R20, Z
OUT PORTA, R20
//MULAI SATUAN
L1:
LPM R20, Z+
ST X+, R20		//SIMPAN NILAI DI R21>>
OUT PORTC, R20
//RCALL DELAY
INC R17
CPI R17, $8	//CEK SATUAN
BRLO L1		
CPI R16, $8	//CEK PERDELAPANAN
BRSH AWALBGT
RJMP DELAPANAN
NEXT:
RJMP AWAL

DELAPANAN:
LD R18, Y+
OUT PORTA, R18
//RCALL DELAY
INC R16
RJMP NEXT

DELAY:
LDI R21, 11
L21:
LDI R22, 0
L22:
LDI R23, 0
L23:
DEC R23
BRNE L23
DEC R22
BRNE L22
DEC R21
BRNE L21
RET

.ORG 80
DAT: 
.DB 0X3F, 0X06, 0X5B, 0X4F, 0X66, 0X6D, 0X7D, 0X07
